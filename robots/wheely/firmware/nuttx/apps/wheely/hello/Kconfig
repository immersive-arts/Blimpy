## robots/wheely/firmware/nuttx/apps/wheely/hello/Kconfig
```kconfig
#
# For a description of the syntax of this configuration file,
# see the file kconfig-language.txt in the NuttX tools repository.
#

config WHEELY_HELLO
	tristate "\"Hello, World!\" example"
	default n
	---help---
		Enable the \"Hello, World!\" example

if WHEELY_HELLO

config WHEELY_HELLO_PROGNAME
	string "Program name"
	default "hello"
	---help---
		This is the name of the program that will be used when the NSH ELF
		program is installed.

config WHEELY_HELLO_PRIORITY
	int "Hello task priority"
	default 100

config WHEELY_HELLO_STACKSIZE
	int "Hello stack size"
	default DEFAULT_TASK_STACKSIZE

endif
```

## robots/wheely/firmware/nuttx/apps/wheely/motor/Kconfig
```kconfig
#
# For a description of the syntax of this configuration file,
# see the file kconfig-language.txt in the NuttX tools repository.
#

config MAXI1M_MOTOR
	tristate "motor"
	default n
	---help---
		Enable the stepper motor

if MAXI1M_MOTOR

config MAXI1M_MOTOR_PROGNAME
	string "Program name"
	default "motor"
	---help---
		This is the name of the program that will be used when the NSH ELF
		program is installed.

config MAXI1M_MOTOR_PRIORITY
	int "motor task priority"
	default 100

config MAXI1M_MOTOR_STACKSIZE
	int "motor stack size"
	default DEFAULT_TASK_STACKSIZE

endif
```

## robots/wheely/firmware/nuttx/nuttx/boards/arm/stm32/wheely/Kconfig
```kconfig
#
# For a description of the syntax of this configuration file,
# see the file kconfig-language.txt in the NuttX tools repository.
#

if ARCH_BOARD_WHEELY

config WHEELY_QETIMER
	int "Timer to use with QE encoder"
	default 4
	depends on SENSORS_QENCODER

endif
```
